## Kconfig
```kconfig
# SPDX-FileCopyrightText: 2026 Ferdinand Keil
# SPDX-License-Identifier: MIT
menu "ASiC-S Signer"

    choice ASICS_KEY_BACKEND
        prompt "Schluessel-Backend"
        default ASICS_KEY_BACKEND_NVS
        help
            Legt fest, wo der private ECDSA-P-256-Schluessel liegt. Der private
            Schluessel verlaesst das Backend nie.

        config ASICS_KEY_BACKEND_NVS
            bool "Light: Schluessel im (verschluesselten) NVS"
            help
                Schluessel wird im NVS abgelegt. Gedacht fuer verschluesseltes NVS
                (nvs_keys-Schema, abgesichert durch Flash Encryption) und Secure Boot v2.

        config ASICS_KEY_BACKEND_SE_STUB
            bool "Externes Secure Element / TPM 2.0 (Stub, nicht implementiert)"
            help
                Platzhalter mit identischer Schnittstelle; liefert ESP_ERR_NOT_SUPPORTED.
    endchoice

    config ASICS_NVS_PARTITION
        string "NVS-Partition"
        default "nvs"
        help
            Name der NVS-Partition. Muss von der Anwendung initialisiert werden
            (nvs_flash_init bzw. nvs_flash_secure_init).

    config ASICS_NVS_NAMESPACE
        string "NVS-Namespace"
        default "asics"

    config ASICS_AUTO_GENERATE_KEY
        bool "Schluessel bei Erstinbetriebnahme automatisch erzeugen"
        default y
        help
            asics_signer_init() erzeugt einen Schluessel, falls keiner vorhanden ist.
            Ein vorhandener Schluessel wird niemals ersetzt.

    config ASICS_BOOTLOADER_RANDOM
        bool "bootloader_random_enable() um die Schluesselerzeugung (nur ESP32-Familie)"
        default y
        help
            Der ESP32-RNG liefert nur bei aktivem WLAN/Bluetooth oder aktivierter
            Rauschquelle echte Zufallszahlen. Diese Option schaltet fuer die Dauer
            der Schluesselerzeugung die Rauschquelle ein. Abschalten, falls der ADC
            anderweitig belegt ist oder RF garantiert aktiv ist.

    config ASICS_REQUIRE_FLASH_ENCRYPTION
        bool "Schluesselerzeugung nur bei aktiver Flash Encryption erlauben"
        default y
        depends on ASICS_KEY_BACKEND_NVS
        help
            Schuetzt den NVS-abgelegten Schluessel. Fuer Entwicklungsaufbauten
            abschalten (es wird eine Warnung protokolliert).

    config ASICS_MIN_TIME
        int "Mindest-Zeitpunkt (Unix-Zeit, 0 = Build-Zeitpunkt)"
        default 0
        range 0 4102444800
        help
            Liegt time() darunter, wird nicht signiert (ESP_ERR_INVALID_STATE).
            0 verwendet den Zeitpunkt des CMake-Konfigurationslaufs.

    config ASICS_CERT_MAX_LEN
        int "Maximale Laenge eines Zertifikats (DER, Bytes)"
        default 1024
        range 512 4096

    config ASICS_MAX_CHAIN
        int "Maximale Gesamtzahl Zertifikate (Geraet + CA-Kette)"
        default 4
        range 2 8
        help
            Geraetezertifikat plus 1..(n-1) CA-Zertifikate (Issuing-CA, Zwischen-CAs,
            optional Root). Der Speicher-Blob ist bis zu n * ASICS_CERT_MAX_LEN gross.

    config ASICS_CMS_BUF_SIZE
        int "Puffergroesse fuer die CMS-Signatur (Bytes, Heap)"
        default 9216 if ASICS_TSA_URL != ""
        default 5120
        range 1024 16384
        help
            Muss das CMS der importierten Kette fassen (Zertifikate + Attribute + Signatur;
            Worst Case grob ASICS_MAX_CHAIN * ASICS_CERT_MAX_LEN + 700 Byte, mehr bei langem
            Issuer-DN des Geraetezertifikats).
            Mit TSA (CONFIG_ASICS_TSA_URL gesetzt) kommt der Zeitstempel-Token (bis
            CONFIG_ASICS_TSA_MAX_RESP) hinzu; der Default steigt dann auf 9216.
            Der Import prueft das per Probe-Build und lehnt Ketten ab, die nicht in den
            Puffer passen (ESP_ERR_NO_MEM).

    config ASICS_ATTRS_BUF_SIZE
        int "Puffergroesse fuer Signed Attributes (Bytes, Heap)"
        default 768
        range 512 4096

    config ASICS_CSR_BUF_SIZE
        int "Puffergroesse fuer den PKCS#10-CSR (Bytes)"
        default 768
        range 384 4096

    config ASICS_PAYLOAD_NAME_MAX
        int "Maximale Laenge des Nutzdatei-Namens"
        default 100
        range 8 255

    config ASICS_WRITE_CHUNK
        int "Maximale Chunk-Groesse pro Schreib-Callback (Bytes)"
        default 4096
        range 64 65536

    config ASICS_SUBJECT_ORG
        string "CSR-Subject: Organisation (O), leer = weglassen"
        default ""

    config ASICS_SUBJECT_COUNTRY
        string "CSR-Subject: Land (C, 2 Buchstaben), leer = weglassen"
        default ""

    config ASICS_TSA_URL
        string "TSA-URL fuer RFC-3161-Zeitstempel (HTTP/HTTPS), leer = keine TSA"
        default ""
        help
            Zeitstempel-Autoritaet fuer CAdES-B-T. Anfrage per HTTP-POST
            (application/timestamp-query). Bei https:// wird das mbedTLS-Zertifikatsbundle
            verwendet, sofern CONFIG_MBEDTLS_CERTIFICATE_BUNDLE aktiv ist. Leer: Zeitstempel
            sind nicht moeglich (ASICS_ERR_TSA_UNAVAILABLE).

    config ASICS_TSA_TIMEOUT_MS
        int "Timeout der TSA-Anfrage (ms)"
        default 5000
        range 500 60000

    choice ASICS_TSA_DEFAULT_MODE
        prompt "Standard-TSA-Modus (zur Laufzeit per asics_set_tsa_mode aenderbar)"
        default ASICS_TSA_DEFAULT_OFF
        help
            OFF: reines CAdES-B-B (kein Zeitstempel). PREFERRED: Zeitstempel versuchen, bei Fehler
            als B-B ausgeben (Ergebnis siehe asics_sign_ex). REQUIRED: bei Fehler nicht signieren.

        config ASICS_TSA_DEFAULT_OFF
            bool "OFF"
        config ASICS_TSA_DEFAULT_PREFERRED
            bool "PREFERRED"
        config ASICS_TSA_DEFAULT_REQUIRED
            bool "REQUIRED"
    endchoice

    config ASICS_TSA_CA_PEM
        string "Pfad zur PEM-Datei der TSA-CA (in die Firmware eingebettet), leer = keine"
        default ""
        help
            Genau eine vertrauenswuerdige TSA-CA (selbstsigniertes Root- oder Zwischen-CA-Zertifikat
            mit CA-Flag). Relative Pfade gelten relativ zum Projektverzeichnis. Ohne TSA-CA koennen
            Zeitstempel nicht geprueft werden: PREFERRED faellt auf B-B zurueck, REQUIRED liefert
            ASICS_ERR_TSA_UNAVAILABLE.

    config ASICS_TSA_POLICY_OID
        string "reqPolicy-OID im TimeStampReq (Punktnotation), leer = weglassen"
        default ""

    config ASICS_TSA_MAX_RESP
        int "Maximale Groesse der TSA-Antwort / des Tokens (Bytes, Heap)"
        default 4096
        range 1024 16384
        help
            Antworten, die nicht in den Puffer passen, werden mit ASICS_ERR_TSA_INVALID abgelehnt.
            Ist CONFIG_ASICS_TSA_URL gesetzt, prueft der Zertifikatsimport, dass das CMS auch mit einem
            Token dieser Groesse in CONFIG_ASICS_CMS_BUF_SIZE passt.

    config ASICS_TSA_GENTIME_TOLERANCE_S
        int "Zulaessige Abweichung der TSA-genTime von der Geraeteuhr (s)"
        default 300
        range 1 86400

    config ASICS_ENABLE_CONSOLE
        bool "UART-Konsolenbefehl 'asics' (status/csr/import)"
        default y

endmenu
```
